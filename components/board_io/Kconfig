## components/board_io/Kconfig
```kconfig
menu "Board I/O"

config BOARD_IO_BUTTON_ENABLE
    bool "Enable board button"
    default n

if BOARD_IO_BUTTON_ENABLE

config BOARD_IO_BUTTON_GPIO
    int "Button GPIO (-1 = unset, init fails until configured)"
    range -1 48
    default -1

config BOARD_IO_BUTTON_ACTIVE_LOW
    bool "Button is active-low"
    default y

choice BOARD_IO_BUTTON_PULL_MODE
    prompt "Button internal pull mode"
    default BOARD_IO_BUTTON_PULL_UP

config BOARD_IO_BUTTON_PULL_NONE
    bool "No internal pull (external resistor required)"

config BOARD_IO_BUTTON_PULL_UP
    bool "Internal pull-up"

config BOARD_IO_BUTTON_PULL_DOWN
    bool "Internal pull-down"

endchoice

config BOARD_IO_BUTTON_DEBOUNCE_MS
    int "Button debounce time (ms)"
    range 5 500
    default 40

config BOARD_IO_BUTTON_RESTART_MS
    int "Restart hold threshold (ms)"
    range 500 30000
    default 2000

config BOARD_IO_BUTTON_FACTORY_RESET_MS
    int "Factory reset hold threshold (ms)"
    range 1000 60000
    default 8000

endif

config BOARD_IO_LED_ENABLE
    bool "Enable status LED"
    default n

if BOARD_IO_LED_ENABLE

config BOARD_IO_LED_GPIO
    int "Status LED GPIO (-1 = unset, init fails until configured)"
    range -1 48
    default -1

config BOARD_IO_LED_ACTIVE_LOW
    bool "Status LED is active-low"
    default n

endif

config BOARD_IO_DISPLAY_ENABLE
    bool "Enable local display"
    default n

if BOARD_IO_DISPLAY_ENABLE

choice BOARD_IO_DISPLAY_BACKEND
    prompt "Display backend"
    default BOARD_IO_DISPLAY_BACKEND_NONE

config BOARD_IO_DISPLAY_BACKEND_NONE
    bool "No hardware backend"

# Add only when implementation exists.
# config BOARD_IO_DISPLAY_BACKEND_SSD1306_I2C
#     bool "SSD1306 over I2C"

endchoice

config BOARD_IO_DISPLAY_REQUIRED
    bool "Display failure is fatal to board_io init"
    default n

config BOARD_IO_DISPLAY_MAX_REFRESH_HZ
    int "Maximum display refresh rate"
    range 1 30
    default 5

# Backend-specific Kconfig is added together with the concrete backend.

endif

config BOARD_IO_TASK_STACK_SIZE
    int "Board I/O task stack size"
    range 2048 8192
    default 3072

config BOARD_IO_TASK_PRIORITY
    int "Board I/O task priority"
    range 1 10
    default 3

endmenu
```

## components/command_dispatcher/Kconfig.projbuild
```kconfig
menu "Command dispatcher"

    config DEVICE_REQUEST_MAX_PENDING
        int "Maximum pending device ACK requests"
        range 2 16
        default 2
        help
            Bounded pending ACK slots. Size for the command executor's
            workers plus queue, independently from the device registry size.

endmenu
```

## components/command_executor/Kconfig.projbuild
```kconfig
menu "Command Executor"

    config CMD_EXEC_WORKER_COUNT
        int "Persistent command worker count"
        range 1 4
        default 2
        help
            Persistent workers that run command_dispatcher_handle() off the
            HTTP server task (Plan v2 §13). Benchmark before tuning; each
            worker costs one task plus one dispatch_result_t (~4.1 KB BSS).

    config CMD_EXEC_QUEUE_LEN
        int "Command job queue length"
        range 1 8
        default 2
        help
            Bounded admission queue sized against the HTTP socket budget
            (Plan v2 §14-§15). Queue-full submissions fail with
            ESP_ERR_NO_MEM so transports can answer 503.

    config CMD_EXEC_WORKER_STACK
        int "Command worker stack size (bytes)"
        range 2048 16384
        default 4096

    config CMD_EXEC_JOB_TIMEOUT_MS
        int "End-to-end command deadline (ms)"
        range 500 60000
        default 3000
        help
            Jobs older than this when dequeued are completed with
            DISPATCH_STATUS_TIMEOUT without being dispatched to BLE
            (Plan v2 §16).

endmenu
```

## components/log_buffer/Kconfig
```kconfig
menu "Log Buffer"

    config LOG_BUFFER_CAPACITY
        int "Number of log entries in ring buffer"
        default 128
        range 32 512
        help
            Number of entries in the RAM ring buffer. Each entry uses
            ~192 bytes of RAM. Default 128 = ~24KB.

    config LOG_BUFFER_TEST_HELPERS
        bool "Expose log buffer test-only helpers"
        default n
        help
            Exposes log_buffer_test_get_ring_mutex() and
            log_buffer_test_reset_metrics() so unit tests can force
            deterministic writer contention and reset metrics. Never enable
            in production firmware.

endmenu
```

## components/mcp_endpoint/Kconfig.projbuild
```kconfig
menu "MCP Endpoint"

    choice MCP_TOOL_SURFACE
        prompt "MCP tool surface mode"
        default MCP_TOOL_SURFACE_DYNAMIC

        config MCP_TOOL_SURFACE_COMPACT
            bool "Compact semantic MCP surface (3 tools)"
            help
                Reduces the default MCP surface to exactly three tools:
                get_status, list_devices, device_control. No dynamic
                per-device tools are exposed. Ideal for Xiaozhi/AI agents.

        config MCP_TOOL_SURFACE_DYNAMIC
            bool "Legacy dynamic per-device MCP tools"
            help
                Preserves the current dynamic tool surface with per-device
                tools added from the capability catalog. Default behavior.
    endchoice

    config MCP_AUTH_TOKEN
        string "Bearer token for POST /mcp"
        default ""
        help
            Required in the Authorization header ("Bearer <token>") for every
            request. Empty disables authentication (dev mode, logged as a
            warning). The token travels over plaintext HTTP: only safe inside
            a trusted LAN.

    config MCP_HOST_ALLOWLIST
        string "Allowed Host headers (comma separated)"
        default "gateway.local,192.168.4.1"
        help
            Requests whose Host header (port stripped, IPv6 literals kept)
            is not on this list are rejected with 403 to blunt DNS rebinding.
            Entries are case-insensitive. Empty disables the check.

    config MCP_DEVICE_COMMAND_ALLOWLIST
        string "Commands allowed via the device_command tool (comma separated)"
        default ""
        help
            Comma-separated list of peripheral commands the device_command
            tool may send (e.g. "toggle,set_power"). Empty denies all device
            commands. Gateway tools are not affected by this list.

    config MCP_EXPOSE_FULL_CAPABILITY_TOOL
        bool "Expose the full device capability tool"
        default n
        help
            Adds the capability-oriented device control tool to tools/list.
            Keep disabled unless the MCP client needs this broader surface.

    config MCP_KEEP_GENERIC_DEVICE_COMMAND
        bool "Expose the legacy generic device_command tool"
        default n
        help
            Keeps the generic device_command tool for compatibility. Commands
            remain restricted by MCP_DEVICE_COMMAND_ALLOWLIST.

    config MCP_COMPAT_2025
        bool "Enable MCP 2024/2025 initialize compatibility"
        default y
        help
            Accept MCP 2024-11-05 and 2025-11-25 initialize/initialized flows
            and subsequent tools/list and tools/call requests. The server does
            not create an MCP-Session-Id and keeps no per-client protocol
            session state.

    config MCP_STRICT_ACCEPT_HEADER
        bool "Require both MCP Streamable HTTP Accept media types"
        default n
        help
            When enabled, requests must include both application/json and
            text/event-stream in the Accept header. When disabled (default),
            missing Accept or JSON-only Accept is accepted for compatibility
            with clients that do not advertise event-stream support.

    config MCP_RATE_LIMIT_RPS
        int "Sustained request rate limit (requests per second)"
        range 1 100
        default 10
        help
            Token bucket refill rate; bucket capacity is fixed at 10 requests.

    config MCP_TOOLS_CACHE_TTL_MS
        int "tools/list cache TTL in milliseconds"
        range 0 60000
        default 60000
        help
            Cache TTL sent in MCP 2026 tools/list responses. Applies to both
            static and dynamic tools/list. Default 60000 preserves existing
            behavior.

endmenu
```

## components/mcp_tool_exposure/Kconfig.projbuild
```kconfig
menu "MCP Dynamic Tools"

    config MCP_DYNAMIC_TOOLS
        bool "Enable dashboard-managed dynamic MCP tools"
        default y

    config MCP_DYNAMIC_TOOL_MAX_ENABLED
        int "Maximum enabled dynamic MCP tools"
        range 8 64
        default 32
        depends on MCP_DYNAMIC_TOOLS

    config MCP_EXPOSURE_RECORD_MAX
        int "Maximum persisted MCP exposure records"
        range 32 192
        default 96
        depends on MCP_DYNAMIC_TOOLS

    config MCP_DYNAMIC_ALLOW_DESTRUCTIVE
        bool "Allow destructive dynamic tools to be enabled"
        default n
        depends on MCP_DYNAMIC_TOOLS
        help
            Even when enabled, the admin API still requires explicit
            confirm_destructive=true per grant.

endmenu
```

## components/mcp_ws_bridge/Kconfig.projbuild
```kconfig
menu "External MCP WebSocket Bridge"

    config MCP_WS_BRIDGE
        bool "Enable external MCP WebSocket bridge"
        default y
        help
            Connect the gateway to an external MCP WebSocket broker. Runtime
            connection remains disabled until an endpoint is configured and
            enabled through Settings.

    config MCP_WS_DEFAULT_ENABLED
        bool "Enable Xiaozhi by default"
        default n
        depends on MCP_WS_BRIDGE
        help
            When enabled, the MCP WebSocket bridge starts automatically at boot
            if no user configuration is stored in NVS.  Factory firmware should
            keep this disabled so the bridge only runs when the user explicitly
            enables it through Settings.

    config MCP_WS_ALLOW_INSECURE
        bool "Allow plaintext ws:// endpoints"
        default n
        depends on MCP_WS_BRIDGE
        help
            Development/LAN only. Production endpoints should use wss://.

    config MCP_WS_MAX_RX_MESSAGE
        int "Maximum received MCP message bytes"
        range 1024 32768
        default 8192
        depends on MCP_WS_BRIDGE

    config MCP_WS_MAX_TX_MESSAGE
        int "Maximum transmitted MCP message bytes"
        range 4096 65536
        default 32768
        depends on MCP_WS_BRIDGE

    config MCP_WS_TX_FRAGMENT_SIZE
        int "WebSocket TX fragment size"
        range 512 4096
        default 1536
        depends on MCP_WS_BRIDGE
        help
            Fragment large MCP responses into bounded WebSocket frames while
            preserving one JSON-RPC response as one WebSocket message.

    config MCP_WS_PSRAM_TX_THRESHOLD
        int "Prefer PSRAM for TX payloads above this size"
        range 512 8192
        default 1024
        depends on MCP_WS_BRIDGE

    config MCP_WS_RELOAD_COOLDOWN_MS
        int "Manual reload cooldown milliseconds"
        range 0 2000
        default 250
        depends on MCP_WS_BRIDGE
        help
            Delay reconnect after destroying the old client so its TLS,
            TCP/IP, and task allocations can be released first.

    config MCP_WS_MEMORY_DIAGNOSTICS
        bool "Log bridge internal/DMA/PSRAM memory snapshots"
        default n
        depends on MCP_WS_BRIDGE
        help
            Development-only diagnostics around connect, destroy, READY, and
            TX. Keep disabled in production to avoid heap queries on hot paths.

    config MCP_WS_EVENT_QUEUE_DEPTH
        int "Bridge event queue depth"
        range 4 32
        default 8
        depends on MCP_WS_BRIDGE

    config MCP_WS_TASK_STACK
        int "Bridge worker stack bytes"
        range 4096 16384
        default 8192
        depends on MCP_WS_BRIDGE

    config MCP_WS_MAX_BACKOFF_MS
        int "Maximum reconnect backoff milliseconds"
        range 1000 300000
        default 60000
        depends on MCP_WS_BRIDGE

    config MCP_WS_HANDSHAKE_TIMEOUT_MS
        int "MCP handshake timeout milliseconds"
        range 1000 60000
        default 10000
        depends on MCP_WS_BRIDGE

endmenu
```

## components/memory_policy/Kconfig.projbuild
```kconfig
menu "Memory Policy"

    config GW_MEM_FALLBACK_MAX_BYTES
        int "Max allocation size for EXTERNAL_PREFERRED fallback to internal (bytes)"
        default 2048
        help
            Allocations larger than this via EXTERNAL_PREFERRED will never
            fall back to internal SRAM.

    config GW_MEM_INTERNAL_FLOOR_BYTES
        int "Internal free floor before allowing fallback (bytes)"
        default 65536
        help
            Minimum internal free heap required after a fallback allocation.
            Fallback is denied if the post-allocation free would drop below
            this threshold.

    config GW_MEM_INTERNAL_LARGEST_FLOOR_BYTES
        int "Internal largest-block floor before allowing fallback (bytes)"
        default 32768
        help
            Minimum largest contiguous internal block required after a
            fallback allocation.

endmenu
```

## components/web_auth/Kconfig.projbuild
```kconfig
menu "Web Authentication"

    config WEB_AUTH_ENABLED
        bool "Enable Web Authentication"
        default y
        help
            Enable password-based authentication for the web dashboard.

    config WEB_AUTH_PBKDF2_ITERATIONS
        int "PBKDF2 iteration count"
        default 60000
        range 10000 200000
        help
            Number of PBKDF2 iterations for password hashing.
            Higher values are more secure but slower.
            Target: password verification ≤ 300ms on ESP32-S3.

    config WEB_AUTH_MAX_SESSIONS
        int "Maximum concurrent sessions"
        default 4
        range 1 16
        help
            Maximum number of concurrent browser sessions.

    config WEB_AUTH_SESSION_IDLE_MINUTES
        int "Session idle timeout (minutes)"
        default 30
        range 5 1440
        help
            Session is invalidated after this many minutes of inactivity.

    config WEB_AUTH_SESSION_MAX_HOURS
        int "Session absolute timeout (hours)"
        default 12
        range 1 720
        help
            Session is invalidated after this many hours regardless of activity.

endmenu
```

## components/web_server/Kconfig.projbuild
```kconfig
menu "Web Server"

    config WEB_ADMIN_AUTH_TOKEN
        string "Admin bearer token for exposure API"
        default ""
        help
            Bearer token for GET/PUT /api/mcp/exposures. Empty disables
            admin auth (exposure mutation fails closed). Can also be set
            at runtime via NVS namespace "web_admin", key "token".

endmenu
```
