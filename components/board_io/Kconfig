## components/wifi_provisioning/Kconfig
```kconfig
menu "Wi-Fi Provisioning"

config WIFI_PROV_AP_PREFIX
    string "Provisioning SoftAP SSID prefix"
    default "ESP-GW"

config WIFI_PROV_AP_PASSWORD
    string "Provisioning SoftAP password"
    default "gateway123"

config WIFI_PROV_AP_MAX_CONNECTIONS
    int "Maximum SoftAP clients"
    range 1 8
    default 4

config WIFI_PROV_STA_BOOT_RETRY_COUNT
    int "Saved credential boot retry count"
    range 0 20
    default 5

config WIFI_PROV_STA_BOOT_TIMEOUT_MS
    int "Saved credential boot timeout (ms)"
    range 1000 120000
    default 30000

config WIFI_PROV_STA_TEST_TIMEOUT_MS
    int "Credential test timeout (ms)"
    range 1000 120000
    default 20000

config WIFI_PROV_CAPTIVE_DHCP_OPTION_114
    bool "Advertise captive portal URI using DHCP option 114"
    default y

config WIFI_PROV_DEV_DEFAULT_ENABLED
    bool "Enable development default Wi-Fi fallback"
    default n
    help
        Development-only Wi-Fi fallback.

        When enabled and no valid Wi-Fi credential exists in NVS,
        the gateway tries WIFI_PROV_DEV_DEFAULT_SSID and
        WIFI_PROV_DEV_DEFAULT_PASSWORD before starting the
        provisioning captive portal.

        NVS credentials always have higher priority.

        Do not enable this option in production firmware because
        credentials are embedded in the firmware image.

if WIFI_PROV_DEV_DEFAULT_ENABLED

config WIFI_PROV_DEV_DEFAULT_SSID
    string "Development default Wi-Fi SSID"
    default ""
    help
        Development Wi-Fi SSID.

        Maximum Wi-Fi SSID length is 32 bytes.

config WIFI_PROV_DEV_DEFAULT_PASSWORD
    string "Development default Wi-Fi password"
    default ""
    help
        Development Wi-Fi password.

        The value is compiled into the firmware image.
        Keep real credentials in sdkconfig.defaults.local and
        never commit that file to source control.

endif

endmenu
```
